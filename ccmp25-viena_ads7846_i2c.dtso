/dts-v1/;
/plugin/;

#include <dt-bindings/gpio/gpio.h>
#include <dt-bindings/interrupt-controller/irq.h>
#include <dt-bindings/input/input.h>

/ {

    fragment@0 {
        target-path = "/";
        __overlay__ {
            overlay-description = "ccmp25viena: tsc2046 Overlay enable I2C TP ";
        };
    };

    fragment@1 {
        target = <&touchscreen>;
        __overlay__ {
            status = "disabled"; 
        };
    };

    fragment@2 {
        target = <&touchscreen_i2c>;
        __overlay__ {
            status = "okay"; 
        };
    };
};