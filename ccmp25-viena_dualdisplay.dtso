/dts-v1/;
/plugin/;

/ {
    compatible = "digi,ccmp25-dvk", "digi,ccmp25", "digi,ccmp2", "st,stm32mp255";

    fragment@0 {
        target-path = "/";
        __overlay__ {
            overlay-description = "ccmp25viena: dual display LVDS + HDMI";
        };
    };
};

fragment@1 {
    target = <&hdmi_connector>;
    __overlay__ {
        status = "okay";
    };
};

fragment@2 {
    target = <&dsi>;
    __overlay__ {
        status = "okay";
    };
};

fragment@3 {
    target = <&lt_bridge>;
    __overlay__ {
        status = "okay";
    };
};