/dts-v1/;
/plugin/;

#include <dt-bindings/pinctrl/stm32-pinfunc.h>

/ {

    fragment@0 {
        target-path = "/";
        __overlay__ {
            overlay-description = "ccmp25plc: GPIO DO_HS2 to PWM Overlay (TIM1_CH2 on PD10)";
        };
    };

    fragment@1 {
        target = <0xc2>;
        __overlay__ {
            status = "okay"; 
        };
    };

    fragment@2 { 
        target = <0x2b>;
        __overlay__ {
            pins {
                /* convert to pwm ：GPIO -> AF8 */
                pinmux = <STM32_PINMUX('D', 10, AF8)>;  
                
            };
        };
    };
};