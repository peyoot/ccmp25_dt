/dts-v1/;
/plugin/;

/ {
    fragment@0 {
        target = <&eth2>;
        __overlay__ {
            max-speed = <100>; 
        };
    };

    fragment@1 {
        target = <&phy1_eth2>;
        __overlay__ {
            max-speed = <100>; 
            ethernet-phy-no-auto-negotiation;
        };
    };
};