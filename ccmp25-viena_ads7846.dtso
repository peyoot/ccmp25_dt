/dts-v1/;
/plugin/;

#include <dt-bindings/gpio/gpio.h>
#include <dt-bindings/interrupt-controller/irq.h>
#include <dt-bindings/input/input.h>

/ {

    fragment@0 {
        target-path = "/";
        __overlay__ {
            overlay-description = "ccmp25viena: tsc2046 Overlay";
        };
    };

    fragment@1 {
        target = <&spi3>;
        __overlay__ {
            // 禁用原有的 spidev 节点
            spidev@0 {
                status = "disabled";
            };
        };
    };

    fragment@2 {
        target = <&touchscreen>;
        __overlay__ {
            status = "okay"; 
        };
    };
};